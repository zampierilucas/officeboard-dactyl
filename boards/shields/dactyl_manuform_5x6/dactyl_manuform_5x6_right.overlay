/*
 * Copyright (c) 2025 The ZMK Contributors
 * SPDX-License-Identifier: MIT
 */

#include <dt-bindings/zmk/matrix_transform.h>

/ {
    chosen {
        zmk,kscan = &kscan0;
    };

    kscan0: kscan {
        compatible = "zmk,kscan-gpio-matrix";
        wakeup-source;

        diode-direction = "col2row";

        row-gpios
            = <&pro_micro 4 (GPIO_ACTIVE_HIGH | GPIO_PULL_DOWN)>  // D8 - Row 0
            , <&pro_micro 5 (GPIO_ACTIVE_HIGH | GPIO_PULL_DOWN)>  // D2 - Row 1
            , <&pro_micro 6 (GPIO_ACTIVE_HIGH | GPIO_PULL_DOWN)>  // D4 - Row 2
            , <&pro_micro 7 (GPIO_ACTIVE_HIGH | GPIO_PULL_DOWN)>  // D5 - Row 3
            , <&pro_micro 3 (GPIO_ACTIVE_HIGH | GPIO_PULL_DOWN)>  // D3 - Row 4
            , <&pro_micro 9 (GPIO_ACTIVE_HIGH | GPIO_PULL_DOWN)>  // D9 - Row 5
            ;

        col-gpios
            = <&pro_micro 19 GPIO_ACTIVE_HIGH> // D19 - Col 0
            , <&pro_micro 18 GPIO_ACTIVE_HIGH> // D18 - Col 1
            , <&pro_micro 15 GPIO_ACTIVE_HIGH> // D15 - Col 2
            , <&pro_micro 14 GPIO_ACTIVE_HIGH> // D14 - Col 3
            , <&pro_micro 16 GPIO_ACTIVE_HIGH> // D16 - Col 4
            , <&pro_micro 10 GPIO_ACTIVE_HIGH> // D10 - Col 5
            ;
    };
};
