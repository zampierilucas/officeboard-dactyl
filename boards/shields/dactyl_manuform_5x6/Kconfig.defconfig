## boards/shields/dactyl_manuform_5x6/Kconfig.defconfig
```kconfig
# Copyright (c) 2025 The ZMK Contributors
# SPDX-License-Identifier: MIT

# ============================================================================
# Dongle mode: left and right as peripherals, dongle as central
# ============================================================================

if SHIELD_DACTYL_MANUFORM_5X6_LEFT

config ZMK_KEYBOARD_NAME
    default "Dactyl 5x6"

config ZMK_SPLIT_ROLE_CENTRAL
    default n

endif

if SHIELD_DACTYL_MANUFORM_5X6_RIGHT

config ZMK_KEYBOARD_NAME
    default "Dactyl 5x6"

config ZMK_SPLIT_ROLE_CENTRAL
    default n

endif

if SHIELD_DACTYL_MANUFORM_5X6_DONGLE

config ZMK_KEYBOARD_NAME
    default "Dactyl 5x6"

config ZMK_SPLIT_ROLE_CENTRAL
    default y

endif

# ============================================================================
# Dongle-less mode: left as central, right as peripheral
# ============================================================================

if SHIELD_DACTYL_MANUFORM_5X6_LEFT_CENTRAL

config ZMK_KEYBOARD_NAME
    default "Dactyl 5x6 BLE"

config ZMK_SPLIT_ROLE_CENTRAL
    default y

endif

if SHIELD_DACTYL_MANUFORM_5X6_RIGHT_PERIPHERAL

# Peripheral should NOT have ZMK_KEYBOARD_NAME - only the central advertises to hosts

config ZMK_SPLIT_ROLE_CENTRAL
    default n

endif

# ============================================================================
# Common split config for all variants
# ============================================================================

if SHIELD_DACTYL_MANUFORM_5X6_LEFT || SHIELD_DACTYL_MANUFORM_5X6_RIGHT || SHIELD_DACTYL_MANUFORM_5X6_DONGLE || SHIELD_DACTYL_MANUFORM_5X6_LEFT_CENTRAL || SHIELD_DACTYL_MANUFORM_5X6_RIGHT_PERIPHERAL

config ZMK_SPLIT
    default y

endif
```

## boards/shields/dactyl_manuform_5x6/Kconfig.shield
```kconfig
# Copyright (c) 2025 The ZMK Contributors
# SPDX-License-Identifier: MIT

# Dongle mode shields (left and right as peripherals)
config SHIELD_DACTYL_MANUFORM_5X6_LEFT
    def_bool $(shields_list_contains,dactyl_manuform_5x6_left)

config SHIELD_DACTYL_MANUFORM_5X6_RIGHT
    def_bool $(shields_list_contains,dactyl_manuform_5x6_right)

config SHIELD_DACTYL_MANUFORM_5X6_DONGLE
    def_bool $(shields_list_contains,dactyl_manuform_5x6_dongle)

# Dongle-less mode shields (left as central, right as peripheral)
config SHIELD_DACTYL_MANUFORM_5X6_LEFT_CENTRAL
    def_bool $(shields_list_contains,dactyl_manuform_5x6_left_central)

config SHIELD_DACTYL_MANUFORM_5X6_RIGHT_PERIPHERAL
    def_bool $(shields_list_contains,dactyl_manuform_5x6_right_peripheral)
```

## config/west.yml
```yaml
manifest:
  defaults:
    revision: feat/battery-reporting
  remotes:
    - name: zmkfirmware
      url-base: https://github.com/zmkfirmware
    - name: genteure
      url-base: https://github.com/Genteure
    # Additional modules containing boards/shields/custom code can be listed here as well
    # See https://docs.zephyrproject.org/3.2.0/develop/west/manifest.html#projects
  projects:
    - name: zmk
      remote: genteure
      revision: feat/battery-reporting
      import: app/west.yml
  self:
    path: config
```
